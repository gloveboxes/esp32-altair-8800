## main/Kconfig.projbuild
```kconfig
menu "Altair 8800"

choice ALTAIR_BOARD
    prompt "Target board"
    default ALTAIR_BOARD_WAVESHARE_ESP32_S3_TOUCH_LCD_3_5B
    help
        Select the physical ESP32-S3 board. This controls board-level pin
        mappings for the display and SD card interfaces.

    config ALTAIR_BOARD_FREENOVE
        bool "Freenove ESP32-S3 with 2.8\" ILI9341 TFT"

    config ALTAIR_BOARD_WAVESHARE_ESP32_S3_TOUCH_LCD_3_5B
        bool "WAVESHARE-ESP32-S3-Touch-LCD-3.5B"
endchoice

choice ALTAIR_DISPLAY_DRIVER
    prompt "Front panel display driver"
    default ALTAIR_DISPLAY_ILI9341 if ALTAIR_BOARD_FREENOVE
    default ALTAIR_DISPLAY_AXS15231B if ALTAIR_BOARD_WAVESHARE_ESP32_S3_TOUCH_LCD_3_5B
    help
        Select the physical front-panel display backend for the target board.

    config ALTAIR_DISPLAY_ILI9341
        bool "ILI9341 TFT (320x240)"
        depends on ALTAIR_BOARD_FREENOVE

    config ALTAIR_DISPLAY_AXS15231B
        bool "AXS15231B QSPI LCD (WAVESHARE-ESP32-S3-Touch-LCD-3.5B)"
        depends on ALTAIR_BOARD_WAVESHARE_ESP32_S3_TOUCH_LCD_3_5B
endchoice

endmenu
```

## sdkconfig.defaults
```kconfig
# Set target to ESP32-S3
CONFIG_IDF_TARGET="esp32s3"

# Use a custom single-app partition table. Bluetooth support now exceeds
# ESP-IDF's built-in 1500K "large" app slot, and this board has 16 MB flash.
CONFIG_PARTITION_TABLE_CUSTOM=y
CONFIG_PARTITION_TABLE_CUSTOM_FILENAME="partitions.csv"
CONFIG_PARTITION_TABLE_FILENAME="partitions.csv"

# Enable BLE HID host for Bluetooth keyboard input.
CONFIG_BT_ENABLED=y
CONFIG_BT_CONTROLLER_ENABLED=y
CONFIG_BT_BLUEDROID_ENABLED=y
CONFIG_BT_BLE_ENABLED=y
CONFIG_BT_BLE_42_FEATURES_SUPPORTED=y
CONFIG_BT_GATTC_ENABLE=y
CONFIG_BT_GATTC_NOTIF_REG_MAX=16
# CONFIG_BT_CLASSIC_ENABLED is not set

# Set CPU frequency to 240 MHz
CONFIG_ESP_DEFAULT_CPU_FREQ_MHZ_240=y

# Disable task watchdog on Core 1 IDLE task
# (Core 1 runs a CPU-intensive emulator that starves IDLE1)
CONFIG_ESP_TASK_WDT_CHECK_IDLE_TASK_CPU1=n

# Set flash size to 16 MB
CONFIG_ESPTOOLPY_FLASHSIZE_16MB=y

# Enable USB Serial JTAG console
CONFIG_ESP_CONSOLE_USB_SERIAL_JTAG=y

# Waveshare ESP32-S3 Touch LCD 3.5B has 8 MB Octal PSRAM. Use it for large
# display buffers so SDMMC, WiFi, and WebSocket keep internal RAM available.
CONFIG_SPIRAM=y
CONFIG_SPIRAM_MODE_OCT=y
CONFIG_SPIRAM_SPEED_80M=y
CONFIG_SPIRAM_USE_MALLOC=y
CONFIG_SPIRAM_MALLOC_ALWAYSINTERNAL=16384
CONFIG_SPIRAM_TRY_ALLOCATE_WIFI_LWIP=y
CONFIG_SPIRAM_MALLOC_RESERVE_INTERNAL=32768

# OpenAI HTTPS runs while BLE, WiFi, SDMMC, and the QSPI display are active.
# Put mbedTLS buffers in PSRAM and let TX/RX buffers be allocated only while
# needed so TLS handshakes do not fail when internal DMA-capable RAM is tight.
# CONFIG_MBEDTLS_INTERNAL_MEM_ALLOC is not set
CONFIG_MBEDTLS_EXTERNAL_MEM_ALLOC=y
CONFIG_MBEDTLS_DYNAMIC_BUFFER=y
CONFIG_MBEDTLS_DYNAMIC_FREE_CONFIG_DATA=y

# BLE HID and WiFi both need internal RAM. Keep WiFi throughput modest so
# keyboard pairing, WebSocket terminal, and the emulator can coexist.
# Static RX/TX buffers (1600 B each) must live in internal DMA-capable RAM;
# 8+8 = ~25 KB and was failing to allocate at boot. Drop to 4+4 to free ~12 KB.
CONFIG_ESP_WIFI_STATIC_RX_BUFFER_NUM=4
CONFIG_ESP_WIFI_STATIC_TX_BUFFER_NUM=4
CONFIG_ESP_WIFI_CACHE_TX_BUFFER_NUM=4
CONFIG_ESP_WIFI_MGMT_SBUF_NUM=16
# RX_BA_WIN must be <= 2 * STATIC_RX_BUFFER_NUM (default 16 violates this with RX=4)
CONFIG_ESP_WIFI_RX_BA_WIN=8

# Increase default task stack size
CONFIG_ESP_MAIN_TASK_STACK_SIZE=4096

# Enable WebSocket support in HTTP server
CONFIG_HTTPD_WS_SUPPORT=y
# Invoke the URI handler's post-handshake callback after the WS handshake so we
# can detect new connections (the handshake itself is consumed internally by
# esp_http_server and never reaches the URI handler).
CONFIG_HTTPD_WS_POST_HANDSHAKE_CB_SUPPORT=y

# LwIP socket configuration - sized for two HTTP servers (captive portal + WebSocket)
# HTTP server uses 3 sockets internally, so max_open_sockets must be <= (MAX_SOCKETS - 3)
# Captive portal default is 7, needs 7+3=10 minimum. Add margin for safety.
CONFIG_LWIP_MAX_SOCKETS=16
CONFIG_LWIP_MAX_ACTIVE_TCP=16
CONFIG_LWIP_MAX_LISTENING_TCP=8

# Socket recycling - keep aggressive settings for clean RST closes
CONFIG_LWIP_TCP_MSL=100
CONFIG_LWIP_TCP_FIN_WAIT_TIMEOUT=1000

# Enable socket options for connection control
CONFIG_LWIP_SO_REUSE=y
CONFIG_LWIP_SO_LINGER=y

CONFIG_LWIP_TCP_MSS=1440

# TCP buffer sizes for WebSocket throughput
# Larger buffers reduce EWOULDBLOCK (error 119) during bursts
CONFIG_LWIP_TCP_SND_BUF_DEFAULT=11488
CONFIG_LWIP_TCP_WND_DEFAULT=11488
CONFIG_LWIP_TCP_RECVMBOX_SIZE=12
CONFIG_LWIP_TCP_QUEUE_OOSEQ=y

# Pin LwIP TCP/IP task to Core 0 to keep Core 1 isolated for the emulator
CONFIG_LWIP_TCPIP_TASK_AFFINITY_CPU0=y
CONFIG_LWIP_TCPIP_TASK_AFFINITY_NO_AFFINITY=n
CONFIG_LWIP_TCPIP_TASK_AFFINITY=0x0

# Enable SO_RCVBUF/SO_SNDBUF socket options
CONFIG_LWIP_SO_RCVBUF=y

# --- Release/performance profile ---
CONFIG_COMPILER_OPTIMIZATION_PERF=y
CONFIG_COMPILER_OPTIMIZATION_ASSERTIONS_DISABLE=y
CONFIG_COMPILER_STACK_CHECK_MODE_NONE=y
CONFIG_FREERTOS_CHECK_STACKOVERFLOW_NONE=y
CONFIG_HEAP_POISONING_DISABLED=y

# Keep only error-level logging in release builds.
CONFIG_BOOTLOADER_LOG_LEVEL_ERROR=y
CONFIG_LOG_DEFAULT_LEVEL_ERROR=y
CONFIG_LOG_MAXIMUM_EQUALS_DEFAULT=y

# Bluetooth has separate trace levels; turn them off for release firmware.
CONFIG_BT_LOG_HCI_TRACE_LEVEL_NONE=y
CONFIG_BT_LOG_BTM_TRACE_LEVEL_NONE=y
CONFIG_BT_LOG_L2CAP_TRACE_LEVEL_NONE=y
CONFIG_BT_LOG_RFCOMM_TRACE_LEVEL_NONE=y
CONFIG_BT_LOG_SDP_TRACE_LEVEL_NONE=y
CONFIG_BT_LOG_GAP_TRACE_LEVEL_NONE=y
CONFIG_BT_LOG_BNEP_TRACE_LEVEL_NONE=y
CONFIG_BT_LOG_PAN_TRACE_LEVEL_NONE=y
CONFIG_BT_LOG_A2D_TRACE_LEVEL_NONE=y
CONFIG_BT_LOG_AVDT_TRACE_LEVEL_NONE=y
CONFIG_BT_LOG_AVCT_TRACE_LEVEL_NONE=y
CONFIG_BT_LOG_AVRC_TRACE_LEVEL_NONE=y
CONFIG_BT_LOG_MCA_TRACE_LEVEL_NONE=y
CONFIG_BT_LOG_HID_TRACE_LEVEL_NONE=y
CONFIG_BT_LOG_APPL_TRACE_LEVEL_NONE=y
CONFIG_BT_LOG_GATT_TRACE_LEVEL_NONE=y
CONFIG_BT_LOG_SMP_TRACE_LEVEL_NONE=y
CONFIG_BT_LOG_BTIF_TRACE_LEVEL_NONE=y
CONFIG_BT_LOG_BTC_TRACE_LEVEL_NONE=y
CONFIG_BT_LOG_OSI_TRACE_LEVEL_NONE=y
CONFIG_BT_LOG_BLUFI_TRACE_LEVEL_NONE=y

# Avoid crash dump and panic-print overhead/noise in release firmware.
CONFIG_ESP_SYSTEM_PANIC_SILENT_REBOOT=y
CONFIG_ESP_COREDUMP_ENABLE_TO_NONE=y
```
